## boards/shields/keyball/Kconfig.shield
```kconfig
config SHIELD_KEYBALL_LEFT
    def_bool $(shields_list_contains,keyball_left)

config SHIELD_KEYBALL_RIGHT
    def_bool $(shields_list_contains,keyball_right)
```
