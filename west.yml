## west.yml
```yaml
manifest:
  remotes:
    - name: badjeff
      url-base: https://github.com/badjeff
    # - name: nicholasptran
    #   url-base: https://github.com/nicholasptran
  projects:
    # - name: zmk-pmw3610-driver
    #   remote: nicholasptran
    #   revision: main
    - name: zmk-pmw3610-driver
      remote: badjeff
      revision: main
```
